## boards/shields/avalanche/Kconfig.shield
```kconfig
# Copyright (c) 2020 Pete Johanson
# SPDX-License-Identifier: MIT

config SHIELD_AVALANCHE_LEFT
    def_bool $(shields_list_contains,avalanche_left)

config SHIELD_AVALANCHE_RIGHT
    def_bool $(shields_list_contains,avalanche_right)
```
